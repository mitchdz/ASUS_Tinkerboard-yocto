## conf/bblayers.conf.sample
```bitbake
POKY_BBLAYERS_CONF_VERSION = "2"

BBPATH = "${TOPDIR}"
BBFILES ?= ""

BBLAYERS ?= " \
	##OEROOT##/meta \
	##OEROOT##/meta-poky \
	##OEROOT##/meta-yocto-bsp \
	##OEROOT##/meta-rockchip \
	##OEROOT##/meta-arm/meta-arm \
	##OEROOT##/meta-arm/meta-arm-bsp \
	##OEROOT##/meta-arm/meta-arm-toolchain \
	##OEROOT##/meta-python2 \
	##OEROOT##/meta-openembedded/meta-oe \
	##OEROOT##/meta-asus-tinkerboard-mitchdz \
	"
```

## conf/layer.conf
```bitbake
# We have a conf and classes directory, add to BBPATH
BBPATH .= ":${LAYERDIR}"

# We have recipes-* directories, add to BBFILES
BBFILES += "${LAYERDIR}/recipes-*/*/*.bb ${LAYERDIR}/recipes-*/*/*.bbappend"

BBFILE_COLLECTIONS += "asus-tinkerboard-mitchdz"
BBFILE_PATTERN_asus-tinkerboard-mitchdz = "^${LAYERDIR}/"
BBFILE_PRIORITY_asus-tinkerboard-mitchdz = "1"

# This should only be incremented on significant changes that will
# cause compatibility issues with other layers
LAYERVERSION_asus-tinkerboard-mitchdz = "1"
LAYERSERIES_COMPAT_asus-tinkerboard-mitchdz = "gatesgarth"
LAYERDEPENDS_asus-tinkerboard-mitchdz = "core meta-arm meta-rockchip"
```
